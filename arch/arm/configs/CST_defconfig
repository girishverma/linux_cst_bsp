## arch/arm/mach-cst/Kconfig
```kconfig
menu "CircuitSutra Custom Board"
	depends on ARCH_CST

config ARCH_CST_CB
	bool "CircuitSutra ARM CORTEX-A9 based Custom Minimal Board."
	default y
	select CPU_V7
	select USB_ARCH_HAS_XHCI
	select NETDEVICES
	help
	  Include support for the Custom Virtual Platform with ARM cortex-A9 core.
endmenu
```
